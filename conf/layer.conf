## conf/layer.conf
```bitbake
# We have a conf and classes directory, add to BBPATH
BBPATH .= ":${LAYERDIR}"

# We have recipes-* directories, add to BBFILES
BBFILES += "${LAYERDIR}/recipes-*/*/*.bb \
            ${LAYERDIR}/recipes-*/*/*.bbappend"

BBFILE_COLLECTIONS += "meta-vk-custom"
BBFILE_PATTERN_meta-vk-custom = "^${LAYERDIR}/"
BBFILE_PRIORITY_meta-vk-custom = "6"

LAYERDEPENDS_meta-vk-custom = "core"
LAYERSERIES_COMPAT_meta-vk-custom = "scarthgap"
```

## conf/machine/conf/machine/ls1046a-fitimage.inc
```bitbake
# LS1046A FIT image configuration
# Include in local.conf: require conf/machine/ls1046a-fitimage.inc
#
# Overrides default KERNEL_IMAGETYPE=Image from qoriq-arm64.inc
# to produce a FIT image containing kernel + DTB + initramfs.

KERNEL_IMAGETYPE = "fitImage"
KERNEL_CLASSES += "kernel-fitimage"

# Initramfs as a separate FIT node (not bundled into kernel binary)
# U-Boot loads kernel, DTB, and ramdisk independently from the FIT
INITRAMFS_IMAGE = "core-image-minimal-initramfs"
INITRAMFS_IMAGE_BUNDLE = "0"

# LS1046A memory map load addresses
UBOOT_ARCH = "arm64"
UBOOT_ENTRYPOINT = "0x80080000"
UBOOT_LOADADDRESS = "0x80080000"
UBOOT_DTB_LOADADDRESS = "0x90000000"
UBOOT_RD_LOADADDRESS = "0xa0000000"
UBOOT_RD_ENTRYPOINT = "0xa0000000"

# FIT metadata
FIT_DESC = "LS1046A OTA FIT Image"
FIT_GENERATE_KEYS ?= "0"
```

## recipes-core/images/data-core.wks
```
# Per-core data partition
# Flashed to each core's dedicated flash independently
# Persistent — never touched by OTA

bootloader --ptable gpt
part /data --source empty --fstype=ext4 --label data --align 16384 --size 4096
```

## recipes-core/images/data-only.wks
```
bootloader --ptable msdos
part /data	--source empty --fstype=ext4 --label data --align 16384 --size 4096
```

## recipes-core/images/factory-provision.wks
```
# Factory provisioning layout for LS1046A shared eMMC
# Creates both rootfs slots and shared environment partition
# Used ONCE at factory. OTA updates write to individual partitions.
#
# Layout:
#   Partition 1: rootfsA (512M, populated with rootfs)
#   Partition 2: rootfsB (512M, populated with same rootfs)
#   Partition 3: shared-env (16M, empty ext4 for shared-env.itb extraction)

bootloader --ptable gpt

part / --source rootfs --fstype=ext4 --label rootfsA --align 16384 --fixed-size 512M
part   --source rootfs --fstype=ext4 --label rootfsB --align 16384 --fixed-size 512M
part   --source empty  --fstype=ext4 --label shared-env --align 4096 --fixed-size 16M
```

## recipes-core/images/rootfs-data.wks
```
bootloader --ptable msdos
part /	--source rootfs --fstype=ext4 --label rootfs --align 16384 --extra-space 200M
part /data	--source empty --fstype=ext4 --label data --align 16384 --size 4096
```

## recipes-core/images/rootfs-only.wks
```
bootloader --ptable msdos
part /	--source rootfs --fstype=ext4 --label rootfs --align 16384 --extra-space 200M
```

## recipes-core/shared-env/recipes-core/shared-env/files/shared-env.its
```
/dts-v1/;

/ {
    description = "LS1046A Shared Environment";
    #address-cells = <1>;

    images {
        env {
            description = "Shared system environment";
            data = /incbin/("shared-env.txt");
            type = "firmware";
            arch = "arm64";
            compression = "none";

            hash-1 {
                algo = "sha256";
            };
        };
    };

    configurations {
        default = "conf-1";

        conf-1 {
            description = "Shared env configuration";
            firmware = "env";
        };
    };
};
```
